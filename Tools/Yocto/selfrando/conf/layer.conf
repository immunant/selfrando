## Tools/Yocto/selfrando/conf/layer.conf
```bitbake
BBPATH .= ":${LAYERDIR}"

BBFILES += "${LAYERDIR}/recipes-*/*/*.bb \
            ${LAYERDIR}/recipes-*/*/*.bbappend"

BBFILE_COLLECTIONS += "selfrando"
BBFILE_PATTERN_selfrando := "^${LAYERDIR}/"
```
